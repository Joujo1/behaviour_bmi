// click_player.ino — ItsyBitsy M4 Express (SAMD51)
//
// Dedicated click-audio player for the behaviour_bmi rig.
//
// The Raspberry Pi is the sole scheduler: it busy-waits to each Poisson
// click time and fires a 100 µs TTL HIGH pulse on BCM10 (left) or BCM9
// (right).  A RISING-edge interrupt here resets the DAC playback position
// to zero; the TC3 timer ISR at 192 kHz clocks out one 12-bit sample per
// channel each period.
//
// Pinout:
//   D9  — left  trigger input  (Pi BCM7 / physical 26)
//   D10 — right trigger input  (Pi BCM1 / physical 28)
//   A0  — left  DAC output  (through 10 µF DC-blocking cap to amplifier)
//   A1  — right DAC output  (through 10 µF DC-blocking cap to amplifier)
//
// Waveform: 4 tones (2/4/8/16 kHz), 40 dB attenuation each, cosine²
// fade-in and fade-out (2 ms each), peak-normalised, 576 samples @ 192 kHz.

#define TRIGGER_LEFT  9
#define TRIGGER_RIGHT 10

// ---------------------------------------------------------------------------
// Uncomment for timing-validation builds only — outputs a 3 ms square pulse
// on both DAC channels instead of the production waveform  so the rising edge
// is threshold-detectable on an oscilloscope.  Leave commented for production.
// ---------------------------------------------------------------------------
//#define SQUARE_PULSE_VALIDATION

// ---------------------------------------------------------------------------
// Pre-baked waveform (generated by run_once_generate_waveform.py)
// 576 samples, 12-bit unsigned, centred at 2048 = silence
// ---------------------------------------------------------------------------
#define CLICK_LEN 576
const uint16_t CLICK_WAV[CLICK_LEN] = {
  2048, 2048, 2048, 2049, 2049, 2050, 2050, 2050, 2050, 2050, 2051, 2052, 2053, 2055, 2057, 2058,
  2057, 2055, 2052, 2049, 2046, 2045, 2047, 2052, 2060, 2069, 2077, 2082, 2083, 2078, 2070, 2059,
  2048, 2040, 2036, 2036, 2041, 2046, 2048, 2046, 2037, 2021, 2002, 1985, 1974, 1973, 1987, 2013,
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  2040, 2039, 2040, 2042, 2043, 2045, 2046, 2046, 2046, 2046, 2047, 2047, 2047, 2048, 2048, 2048,
};

// ---------------------------------------------------------------------------
// Playback state — written by trigger ISR, read by timer ISR.
// Cortex-M4 16-bit aligned loads/stores are atomic → no mutex needed.
// CLICK_LEN or greater means idle (DAC outputs silence).
// ---------------------------------------------------------------------------
volatile uint16_t pos_left  = CLICK_LEN;
volatile uint16_t pos_right = CLICK_LEN;

// ---------------------------------------------------------------------------
// Trigger ISRs — reset playback position on RISING edge
// ---------------------------------------------------------------------------
void onLeftTrigger()  { pos_left  = 0; }
void onRightTrigger() { pos_right = 0; }

// ---------------------------------------------------------------------------
// TC3 timer ISR — fires at 192 kHz (120 MHz / 625)
// Outputs one 12-bit DAC sample per channel per period.
// ---------------------------------------------------------------------------
void TC3_Handler() {
    TC3->COUNT16.INTFLAG.bit.MC0 = 1;  // clear Match/Compare 0 flag

    uint16_t pl = pos_left;
    uint16_t pr = pos_right;

    // SAMD51: must wait for previous conversion to finish before writing DATA[n].
    // At 192 kHz the DAC is nearly always ready; the loop rarely iterates.
    while (DAC->SYNCBUSY.bit.DATA0);
#ifdef SQUARE_PULSE_VALIDATION
    DAC->DATA[0].reg = (pl < CLICK_LEN) ? 4095 : 2048;
#else
    DAC->DATA[0].reg = (pl < CLICK_LEN) ? CLICK_WAV[pl] : 2048;
#endif
    while (DAC->SYNCBUSY.bit.DATA1);
#ifdef SQUARE_PULSE_VALIDATION
    DAC->DATA[1].reg = (pr < CLICK_LEN) ? 4095 : 2048;
#else
    DAC->DATA[1].reg = (pr < CLICK_LEN) ? CLICK_WAV[pr] : 2048;
#endif

    if (pl < CLICK_LEN) pos_left  = pl + 1;
    if (pr < CLICK_LEN) pos_right = pr + 1;
}

// ---------------------------------------------------------------------------
// TC3 setup — 16-bit Match-Frequency mode, no prescaler, period = 624
// GCLK0 = 120 MHz → 120 000 000 / 625 = 192 000 Hz
// ---------------------------------------------------------------------------
static void setup_tc3_192kHz() {
    // Open the APB peripheral bus clock for TC3.  GCLK routing alone is not
    // enough on SAMD51 — the MCLK gate must also be set.  This is idempotent
    // if the Arduino core already enabled it (e.g. for PWM on this pin).
    MCLK->APBBMASK.reg |= MCLK_APBBMASK_TC3;

    // Route GCLK0 (120 MHz) to TC3 (SAMD51 uses per-peripheral PCHCTRL with TC3_GCLK_ID)
    GCLK->PCHCTRL[TC3_GCLK_ID].reg = GCLK_PCHCTRL_GEN_GCLK0 | GCLK_PCHCTRL_CHEN;
    while (!GCLK->PCHCTRL[TC3_GCLK_ID].bit.CHEN);

    // Software reset
    TC3->COUNT16.CTRLA.bit.SWRST = 1;
    while (TC3->COUNT16.SYNCBUSY.bit.SWRST);

    // 16-bit mode, no prescaler (SAMD51: WAVEGEN moved to separate WAVE register)
    TC3->COUNT16.CTRLA.reg = TC_CTRLA_MODE_COUNT16 | TC_CTRLA_PRESCALER_DIV1;
    TC3->COUNT16.WAVE.reg  = TC_WAVE_WAVEGEN_MFRQ;  // counter resets to 0 at CC[0]
    TC3->COUNT16.CC[0].reg = 624;   // period = 625 counts = 192 kHz
    while (TC3->COUNT16.SYNCBUSY.bit.CC0);

    // Enable Match/Compare 0 interrupt at highest hardware priority
    TC3->COUNT16.INTENSET.bit.MC0 = 1;
    NVIC_SetPriority(TC3_IRQn, 0);
    NVIC_EnableIRQ(TC3_IRQn);

    // Enable the timer
    TC3->COUNT16.CTRLA.bit.ENABLE = 1;
    while (TC3->COUNT16.SYNCBUSY.bit.ENABLE);
}

// ---------------------------------------------------------------------------
void setup() {
    // Enable both 12-bit DAC channels and set them to mid-rail (silence).
    // analogWrite initialises the DAC peripheral; subsequent writes in the
    // ISR go directly to DAC->DATA[n].reg for lowest latency.
    analogWriteResolution(12);
    analogWrite(A0, 2048);
    analogWrite(A1, 2048);

    // Force VDDANA (3.3 V) as DAC reference — analogWrite() may leave it on
    // the internal bandgap (~1.2 V), which would cap peak output at ~1.2 V.
    while (DAC->SYNCBUSY.bit.SWRST || DAC->SYNCBUSY.bit.ENABLE);
    DAC->CTRLB.bit.REFSEL = 0x02;  // VDDANA on SAMD51

    setup_tc3_192kHz();

    pinMode(TRIGGER_LEFT,  INPUT);
    pinMode(TRIGGER_RIGHT, INPUT);
    attachInterrupt(digitalPinToInterrupt(TRIGGER_LEFT),  onLeftTrigger,  RISING);
    attachInterrupt(digitalPinToInterrupt(TRIGGER_RIGHT), onRightTrigger, RISING);
}

void loop() {
    // Everything is interrupt-driven — nothing to do here.
}
